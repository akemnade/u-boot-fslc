## board/kobo/mx6sllclara2e/Kconfig
```kconfig
if TARGET_MX6SLLKOBOCLARA2E

config SYS_BOARD
	default "mx6sllclara2e"

config SYS_VENDOR
	default "kobo"

config SYS_CONFIG_NAME
	default "mx6sllclara2e"

config IMX_CONFIG
	default "board/kobo/mx6sllclara2e/imximage.cfg"

source "board/kobo/common/Kconfig"

endif
```

## board/kobo/mx6sllclarahd/Kconfig
```kconfig
if TARGET_MX6SLLKOBOCLARAHD

config SYS_BOARD
	default "mx6sllclarahd"

config SYS_VENDOR
	default "kobo"

config SYS_CONFIG_NAME
	default "mx6sllclarahd"

config IMX_CONFIG
	default "board/kobo/mx6sllclarahd/imximage.cfg"

source "board/kobo/common/Kconfig"
endif
```

## board/kobo/mx6sltolinopage2/Kconfig
```kconfig
if TARGET_MX6SLTOLINOPAGE2

config SYS_BOARD
	default "mx6sltolinopage2"

config SYS_VENDOR
	default "kobo"

config SYS_CONFIG_NAME
	default "mx6sltolinopage2"

config IMX_CONFIG
	default "board/kobo/mx6sltolinopage2/imximage.cfg"

source "board/kobo/common/Kconfig"
endif
```

## board/kobo/mx6sltolinoshine3/Kconfig
```kconfig
if TARGET_MX6SLTOLINOSHINE3

config SYS_BOARD
	default "mx6sltolinoshine3"

config SYS_VENDOR
	default "kobo"

config SYS_CONFIG_NAME
	default "mx6sltolinoshine3"

config IMX_CONFIG
	default "board/kobo/mx6sltolinoshine3/imximage.cfg"

source "board/kobo/common/Kconfig"
endif
```

## board/kobo/mx6ullnia/Kconfig
```kconfig
if TARGET_MX6ULLKOBONIA

config SYS_BOARD
	default "mx6ullnia"

config SYS_VENDOR
	default "kobo"

config SYS_CONFIG_NAME
	default "mx6ullnia"

config IMX_CONFIG
	default "board/kobo/mx6ullnia/imximage.cfg"

source "board/kobo/common/Kconfig"
endif
```
